AUTOSAR XML (schema 00048)
package /RB/UBK/Project/EcucModuleConfigurationValuess
  module config EcuC
    EcucPartitionCollection
      DefaultEcucPartition (EcucPartition):
        PartitionCanBeRestarted = false
        EcucPartitionSoftwareComponentInstanceRef = ioHWAb
        EcucPartitionSoftwareComponentInstanceRef = LeftDoorSensor
        EcucPartitionSoftwareComponentInstanceRef = RightDoorSensor
        EcucPartitionSoftwareComponentInstanceRef = LightManager
        EcucPartitionSoftwareComponentInstanceRef = FrontLightActuator
  module definition EcuC
    container EcucPartitionCollection
      container EcucPartition
        boolean PartitionCanBeRestarted
        instance reference EcucPartitionSoftwareComponentInstanceRef
  module config Os
    Alarm1 (OsAlarm): OsAlarmCounterRef=EE_Counter0
      OsAlarmAction
        OsAlarmActivateTask: OsAlarmActivateTaskRef=TaskRightDoorSensor
      OsAlarmAutostart: OsAlarmAlarmTime=1, OsAlarmAutostartType=ABSOLUTE, OsAlarmCycleTime=50, OsAlarmAppModeRef=OSDEFAULTAPPMODE
    Alarm2 (OsAlarm): OsAlarmCounterRef=EE_Counter0
      OsAlarmAction
        OsAlarmActivateTask: OsAlarmActivateTaskRef=TaskLeftDoorSensor
      OsAlarmAutostart: OsAlarmAlarmTime=1, OsAlarmAutostartType=ABSOLUTE, OsAlarmCycleTime=50, OsAlarmAppModeRef=OSDEFAULTAPPMODE
    OsApplication_DefaultEcucPartition (OsApplication):
      OsApplicationStackSize = 8192
      OsAppAlarmRef = Alarm2
      OsAppAlarmRef = Alarm1
      OsAppCounterRef = EE_Counter0
      OsAppEcucPartitionRef = DefaultEcucPartition
      OsAppTaskRef = TaskReadLeft
      OsAppTaskRef = TaskReadRight
      OsAppTaskRef = TaskWrite
      OsAppTaskRef = TaskGetResultLeft
      OsAppTaskRef = TaskGetResultRight
      OsAppTaskRef = TaskLeftDoorSensor
      OsAppTaskRef = TaskReceiveLightStatus
      OsAppTaskRef = TaskRightDoorSensor
      OsAppTaskRef = TaskReceiveRightDoor
      OsAppTaskRef = TaskReceiveLeftDoor
    EE_Counter0 (OsCounter):
      OsCounterMaxAllowedValue = 2147483647
      OsCounterMinCycle = 1
      OsCounterTicksPerBase = 1
      OsCounterType = HARDWARE
      OsSecondsPerTick = 0.001
      OsCounterAccessingApplication = OsApplication_DefaultEcucPartition
    OsOS: OsNumberOfCores=1, OsStackMonitoring=true, OsStatus=EXTENDED, OsUseGetServiceId=true, OsUseParameterAccess=true, OsUseResScheduler=true
    10 x OsTask, all with OsTaskSchedule=FULL:
      TaskReadLeft: OsTaskActivation=1, OsTaskPriority=7
      TaskReadRight: OsTaskActivation=1, OsTaskPriority=6
      TaskWrite: OsTaskActivation=1, OsTaskPriority=8
      TaskGetResultLeft: OsTaskActivation=11, OsTaskPriority=2
      TaskGetResultRight: OsTaskActivation=1, OsTaskPriority=1
      TaskLeftDoorSensor: OsTaskActivation=1, OsTaskPriority=3, OsTaskStackSize=512
      TaskReceiveLeftDoor: OsTaskActivation=1, OsTaskPriority=5, OsTaskStackSize=512
      TaskReceiveLightStatus: OsTaskActivation=1, OsTaskPriority=6, OsTaskStackSize=512
      TaskReceiveRightDoor: OsTaskActivation=1, OsTaskPriority=5, OsTaskStackSize=512
      TaskRightDoorSensor: OsTaskActivation=1, OsTaskPriority=4, OsTaskStackSize=512
  module definition Os
    container OsAlarm
      reference OsAlarmCounterRef
      choice container OsAlarmAction
        container OsAlarmActivateTask
          reference OsAlarmActivateTaskRef
      container OsAlarmAutostart
        integer OsAlarmAlarmTime
        enumeration OsAlarmAutostartType
        integer OsAlarmCycleTime
        reference OsAlarmAppModeRef
    container OsApplication
      integer OsApplicationStackSize
      reference OsAppAlarmRef
      reference OsAppCounterRef
      reference OsAppEcucPartitionRef
      reference OsAppTaskRef
    container OsCounter
      integer OsCounterMaxAllowedValue
      integer OsCounterMinCycle
      integer OsCounterTicksPerBase
      enumeration OsCounterType
      float OsSecondsPerTick
      reference OsCounterAccessingApplication
    container OsOS
      integer OsNumberOfCores
      boolean OsStackMonitoring
      enumeration OsStatus
      boolean OsUseGetServiceId
      boolean OsUseParameterAccess
      boolean OsUseResScheduler
    container OsTask
      integer OsTaskActivation
      integer OsTaskPriority
      enumeration OsTaskSchedule
      integer OsTaskStackSize
  module config Rte
    RteGeneration:
      RteBypassSupport = NONE
      RteCalibrationSupport = NONE
      RteCodeVendorId = 0
      RteDevErrorDetect = false
      RteDevErrorDetectUninit = false
      RteGenerationMode = COMPATIBILITY_MODE
      RteInExclusiveAreaCheckEnabled = true
      RteMeasurementSupport = false
      RteOptimizationMode = RUNTIME
      RteToolChainSignificantCharacters = 31
      RteValueRangeCheckEnabled = false
      RteVfbTraceEnabled = false
    RteInitializationBehavior_0 (RteInitializationBehavior): RteInitializationStrategy=RTE_INITIALIZATION_STRATEGY_NONE, RteSectionInitializationPolicy=NO-INIT
    RteOsInteraction_0 (RteOsInteraction)
    5 x RteSwComponentInstance:
      Source_FrontLightActuator: RteSoftwareComponentInstanceRef=FrontLightActuator
        EventMappingReceiveEventLightStatus (RteEventToTaskMapping): RteImmediateRestart=false, RtePositionInTask=1, RteEventRef=ReceiveEventLightStatus, RteMappedToTaskRef=TaskReceiveLightStatus
      Source_LeftDoorSensor: RteSoftwareComponentInstanceRef=LeftDoorSensor
        EventMappingGetResultEventDigitalServiceReadLeft (RteEventToTaskMapping): RteImmediateRestart=false, RtePositionInTask=1, RteEventRef=GetResultEventDigitalServiceReadLeft, RteMappedToTaskRef=TaskGetResultLeft
        EventMappingLeftDoorSensorTimingEvent (RteEventToTaskMapping):
          RteImmediateRestart = false
          RtePositionInTask = 1
          RteEventRef = LeftDoorSensorTimingEvent
          RteMappedToTaskRef = TaskLeftDoorSensor
          RteUsedOsAlarmRef = Alarm2
      Source_LightManager: RteSoftwareComponentInstanceRef=LightManager
        EventMapping_ReceiveEventLeftDoorStatus (RteEventToTaskMapping): RteImmediateRestart=false, RtePositionInTask=1, RteEventRef=ReceiveEventLeftDoorStatus, RteMappedToTaskRef=TaskReceiveLeftDoor
        EventMapping_ReceiveEventRightDoorStatus (RteEventToTaskMapping): RteImmediateRestart=false, RtePositionInTask=1, RteEventRef=ReceiveEventRightDoorStatus, RteMappedToTaskRef=TaskReceiveRightDoor
      Source_RightDoorSensor: RteSoftwareComponentInstanceRef=RightDoorSensor
        EventMappingGetResultEventDigitalServiceReadRight (RteEventToTaskMapping): RteImmediateRestart=false, RtePositionInTask=1, RteEventRef=GetResultEventDigitalServiceReadRight, RteMappedToTaskRef=TaskGetResultRight
        EventMappingRightDoorSensorTimingEvent (RteEventToTaskMapping):
          RteImmediateRestart = false
          RtePositionInTask = 1
          RteEventRef = RightDoorSensorTimingEvent
          RteMappedToTaskRef = TaskRightDoorSensor
          RteUsedOsAlarmRef = Alarm1
      Source_ioHWAb: RteSoftwareComponentInstanceRef=ioHWAb
        3 x RteEventToTaskMapping, all with RteImmediateRestart=false, RtePositionInTask=1:
          EventMappingEventDigitalServiceReadLeft: RteEventRef=EventDigitalServiceReadLeft, RteMappedToTaskRef=TaskReadLeft
          EventMappingEventDigitalServiceReadRight: RteEventRef=EventDigitalServiceReadRight, RteMappedToTaskRef=TaskReadRight
          EventMappingEventDigitalServiceWrite: RteEventRef=EventDigitalServiceWrite, RteMappedToTaskRef=TaskWrite
  module definition Rte
    container RteGeneration
      enumeration RteBypassSupport
      enumeration RteCalibrationSupport
      integer RteCodeVendorId
      boolean RteDevErrorDetect
      boolean RteDevErrorDetectUninit
      enumeration RteGenerationMode
      boolean RteInExclusiveAreaCheckEnabled
      boolean RteMeasurementSupport
      enumeration RteOptimizationMode
      integer RteToolChainSignificantCharacters
      boolean RteValueRangeCheckEnabled
      boolean RteVfbTraceEnabled
    container RteInitializationBehavior
      enumeration RteInitializationStrategy
      string RteSectionInitializationPolicy
    container RteOsInteraction
    container RteSwComponentInstance
      foreign reference RteSoftwareComponentInstanceRef
      container RteEventToTaskMapping
        boolean RteImmediateRestart
        integer RtePositionInTask
        foreign reference RteEventRef
        reference RteMappedToTaskRef
        reference RteUsedOsAlarmRef
