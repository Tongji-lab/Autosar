AUTOSAR XML (schema 00048)
package /RB/UBK/Project/EcucModuleConfigurationValuess
  module config EcuC
    EcucPartitionCollection
      DefaultEcucPartition (EcucPartition): PartitionCanBeRestarted=false, EcucPartitionSoftwareComponentInstanceRef=Sender, EcucPartitionSoftwareComponentInstanceRef=Receiver
  module definition EcuC
    container EcucPartitionCollection
      container EcucPartition
        boolean PartitionCanBeRestarted
        instance reference EcucPartitionSoftwareComponentInstanceRef
  module config Os
    Alarm1 (OsAlarm): OsAlarmCounterRef=EE_Counter0
      OsAlarmAction
        OsAlarmActivateTask: OsAlarmActivateTaskRef=TaskReceiver
      OsAlarmAutostart: OsAlarmAlarmTime=1, OsAlarmAutostartType=ABSOLUTE, OsAlarmCycleTime=50, OsAlarmAppModeRef=OSDEFAULTAPPMODE
    Alarm2 (OsAlarm): OsAlarmCounterRef=EE_Counter0
      OsAlarmAction
        OsAlarmActivateTask: OsAlarmActivateTaskRef=TaskSender
      OsAlarmAutostart: OsAlarmAlarmTime=1, OsAlarmAutostartType=ABSOLUTE, OsAlarmCycleTime=50, OsAlarmAppModeRef=OSDEFAULTAPPMODE
    OsApplication_DefaultEcucPartition (OsApplication):
      OsApplicationStackSize = 8192
      OsAppAlarmRef = Alarm2
      OsAppAlarmRef = Alarm1
      OsAppCounterRef = EE_Counter0
      OsAppEcucPartitionRef = DefaultEcucPartition
      OsAppTaskRef = TaskSender
      OsAppTaskRef = TaskReceiver
    EE_Counter0 (OsCounter):
      OsCounterMaxAllowedValue = 2147483647
      OsCounterMinCycle = 1
      OsCounterTicksPerBase = 1
      OsCounterType = HARDWARE
      OsSecondsPerTick = 0.001
      OsCounterAccessingApplication = OsApplication_DefaultEcucPartition
    OsOS: OsNumberOfCores=1, OsStackMonitoring=true, OsStatus=EXTENDED, OsUseGetServiceId=true, OsUseParameterAccess=true, OsUseResScheduler=true
    TaskReceiver (OsTask): OsTaskActivation=1, OsTaskPriority=1, OsTaskSchedule=FULL, OsTaskStackSize=512
    TaskSender (OsTask): OsTaskActivation=1, OsTaskPriority=2, OsTaskSchedule=FULL, OsTaskStackSize=512
  module definition Os
    container OsAlarm
      reference OsAlarmCounterRef
      choice container OsAlarmAction
        container OsAlarmActivateTask
          reference OsAlarmActivateTaskRef
      container OsAlarmAutostart
        integer OsAlarmAlarmTime
        enumeration OsAlarmAutostartType
        integer OsAlarmCycleTime
        reference OsAlarmAppModeRef
    container OsApplication
      integer OsApplicationStackSize
      reference OsAppAlarmRef
      reference OsAppCounterRef
      reference OsAppEcucPartitionRef
      reference OsAppTaskRef
    container OsCounter
      integer OsCounterMaxAllowedValue
      integer OsCounterMinCycle
      integer OsCounterTicksPerBase
      enumeration OsCounterType
      float OsSecondsPerTick
      reference OsCounterAccessingApplication
    container OsOS
      integer OsNumberOfCores
      boolean OsStackMonitoring
      enumeration OsStatus
      boolean OsUseGetServiceId
      boolean OsUseParameterAccess
      boolean OsUseResScheduler
    container OsTask
      integer OsTaskActivation
      integer OsTaskPriority
      enumeration OsTaskSchedule
      integer OsTaskStackSize
  module config Rte
    RteGeneration:
      RteBypassSupport = NONE
      RteCalibrationSupport = NONE
      RteCodeVendorId = 0
      RteDevErrorDetect = false
      RteDevErrorDetectUninit = false
      RteGenerationMode = COMPATIBILITY_MODE
      RteInExclusiveAreaCheckEnabled = true
      RteMeasurementSupport = false
      RteOptimizationMode = RUNTIME
      RteToolChainSignificantCharacters = 31
      RteValueRangeCheckEnabled = false
      RteVfbTraceEnabled = false
    RteInitializationBehavior_0 (RteInitializationBehavior): RteInitializationStrategy=RTE_INITIALIZATION_STRATEGY_NONE, RteSectionInitializationPolicy=NO-INIT
    RteOsInteraction_0 (RteOsInteraction)
    Source_Receiver (RteSwComponentInstance): RteSoftwareComponentInstanceRef=Receiver
      EventMappingReceiverTimingEvent (RteEventToTaskMapping): RteImmediateRestart=false, RtePositionInTask=1, RteEventRef=ReceiverTimingEvent, RteMappedToTaskRef=TaskReceiver, RteUsedOsAlarmRef=Alarm1
    Source_Sender (RteSwComponentInstance): RteSoftwareComponentInstanceRef=Sender
      EventMappingSenderTimingEvent (RteEventToTaskMapping): RteImmediateRestart=false, RtePositionInTask=1, RteEventRef=SenderTimingEvent, RteMappedToTaskRef=TaskSender, RteUsedOsAlarmRef=Alarm2
  module definition Rte
    container RteGeneration
      enumeration RteBypassSupport
      enumeration RteCalibrationSupport
      integer RteCodeVendorId
      boolean RteDevErrorDetect
      boolean RteDevErrorDetectUninit
      enumeration RteGenerationMode
      boolean RteInExclusiveAreaCheckEnabled
      boolean RteMeasurementSupport
      enumeration RteOptimizationMode
      integer RteToolChainSignificantCharacters
      boolean RteValueRangeCheckEnabled
      boolean RteVfbTraceEnabled
    container RteInitializationBehavior
      enumeration RteInitializationStrategy
      string RteSectionInitializationPolicy
    container RteOsInteraction
    container RteSwComponentInstance
      foreign reference RteSoftwareComponentInstanceRef
      container RteEventToTaskMapping
        boolean RteImmediateRestart
        integer RtePositionInTask
        foreign reference RteEventRef
        reference RteMappedToTaskRef
        reference RteUsedOsAlarmRef
